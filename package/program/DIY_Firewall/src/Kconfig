## package/program/DIY_Firewall/src/Kconfig
```kconfig
config DIY_FIREWALL
	tristate "DIY firewall by cloudbeacon"
	bool DIY Firewall
	help
		This is a linux kernel program for debugging kernel model.
```

## target/linux/ramips/files/drivers/mtd/ralink/Kconfig
```kconfig
menu "Ralink Flash Type support"

config MTD_RALINK
	tristate "Ralink MTD support"
	depends on MTD

endmenu
```
